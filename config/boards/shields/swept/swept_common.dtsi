/{
    split_inputs {
        #address-cells = <1>;
        #size-cells = <0>;

        tps65_split: tps65_split@74 {
            compatible = "zmk,input-split";
            reg = <0x74>;
        };
    };
 
	tps65_listener: tps65_listener {
        compatible = "zmk,input-listener";
        status = "disabled";
        device = <&tps65_split>;
    };

};
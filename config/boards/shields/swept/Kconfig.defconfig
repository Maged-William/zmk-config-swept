## config/boards/shields/swept/Kconfig.defconfig
```kconfig
# Copyright (c) 2020 The ZMK Contributors
# SPDX-License-Identifier: MIT

if SHIELD_SWEPT_LEFT

config ZMK_KEYBOARD_NAME
	default "Swept tmls"

endif
```

## config/west.yml
```yaml
manifest:
  remotes:
    - name: zmkfirmware
      url-base: https://github.com/zmkfirmware
    - name: AYM1607
      url-base: https://github.com/AYM1607
    - name: TooManyLs
      url-base: https://github.com/TooManyLs
    - name: carrefinho
      url-base: https://github.com/carrefinho
  projects:
    - name: zmk
      remote: zmkfirmware
      revision: main
      import: app/west.yml
    - name: zmk-driver-azoteq-iqs5xx
      remote: TooManyLs
      revision: main
    - name: prospector-zmk-module
      remote: carrefinho
      revision: core/zephyr-4-1
  self:
    path: config
```
